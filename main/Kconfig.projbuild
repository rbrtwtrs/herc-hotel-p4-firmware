## main/Kconfig.projbuild
```kconfig
menu "Hotel Camera Configuration"

    config EXAMPLE_CAMERA_VIDEO_BUFFER_NUMBER
        int "Camera video buffer number"
        default 2

    config EXAMPLE_JPEG_COMPRESSION_QUALITY
        int "JPEG compression quality"
        default 80
        range 1 100

    config EXAMPLE_HTTP_PART_BOUNDARY
        string "HTTP part boundary"
        default "123456789000000000000987654321"

    config EXAMPLE_MDNS_INSTANCE
        string "mDNS instance"
        default "herc-hotel-camera"

    config EXAMPLE_MDNS_HOST_NAME
        string "mDNS host name"
        default "herc-hotel-p4"

endmenu
```

## sdkconfig.defaults
```kconfig
CONFIG_IDF_TARGET="esp32p4"
CONFIG_IDF_TARGET_ESP32P4=y
CONFIG_ESPTOOLPY_FLASHSIZE_16MB=y
CONFIG_ESPTOOLPY_FLASHSIZE="16MB"
CONFIG_PARTITION_TABLE_CUSTOM=y
CONFIG_PARTITION_TABLE_CUSTOM_FILENAME="partitions_ota.csv"
CONFIG_PARTITION_TABLE_FILENAME="partitions_ota.csv"
CONFIG_APP_ROLLBACK_ENABLE=y
CONFIG_ESP_HTTP_CLIENT_ENABLE_HTTPS=y
CONFIG_ESP_HTTPS_OTA_ALLOW_HTTP=y
CONFIG_OTA_ALLOW_HTTP=y
CONFIG_BOOTLOADER_APP_ROLLBACK_ENABLE=y

CONFIG_ESP32P4_REV_MIN_1=y
CONFIG_ESP32P4_SELECTS_REV_LESS_V3=y
CONFIG_IDF_EXPERIMENTAL_FEATURES=y

CONFIG_SPIRAM=y
CONFIG_SPIRAM_SPEED_200M=y

CONFIG_CAMERA_OV5647=y
CONFIG_CAMERA_OV5647_AUTO_DETECT_MIPI_INTERFACE_SENSOR=y
CONFIG_CAMERA_OV5647_MIPI_RAW8_800X1280_50FPS=y
CONFIG_CAMERA_SC2336=y

CONFIG_ESP_VIDEO_ENABLE_ISP_PIPELINE_CONTROLLER=y
CONFIG_EXAMPLE_SELECT_ESP32P4_FUNCTION_EV_BOARD_V1_5=y
CONFIG_EXAMPLE_ENABLE_MIPI_CSI_CAM_SENSOR=y
CONFIG_EXAMPLE_CAMERA_VIDEO_BUFFER_NUMBER=2
CONFIG_EXAMPLE_JPEG_COMPRESSION_QUALITY=95
CONFIG_EXAMPLE_HTTP_PART_BOUNDARY="123456789000000000000987654321"
CONFIG_EXAMPLE_MDNS_INSTANCE="herc-hotel-camera"
CONFIG_EXAMPLE_MDNS_HOST_NAME="herc-hotel-p4"
CONFIG_EXAMPLE_SELECT_JPEG_HW_DRIVER=y

CONFIG_LWIP_TCPIP_RECVMBOX_SIZE=64
CONFIG_LWIP_TCP_SND_BUF_DEFAULT=65535
CONFIG_LWIP_TCP_WND_DEFAULT=65535
CONFIG_LWIP_TCP_RECVMBOX_SIZE=64
CONFIG_LWIP_MAX_SOCKETS=22
CONFIG_VFS_MAX_COUNT=10
CONFIG_ESP_SYSTEM_EVENT_TASK_STACK_SIZE=8192
CONFIG_SYSTEM_EVENT_TASK_STACK_SIZE=8192
CONFIG_ESP_MAIN_TASK_STACK_SIZE=8192
CONFIG_MAIN_TASK_STACK_SIZE=8192
```
